## firmware/voidlink-ncm-adapter/main/Kconfig.projbuild
```kconfig
menu "VoidLink Adapter"

config VOIDLINK_ENABLE_PAIRING_UI
    bool "Enable host-facing USB pairing UI"
    default y
    help
        Starts the DHCP-backed USB NCM interface and the local web UI at
        http://192.168.4.1/ for pairing/control workflows.

endmenu
```

## firmware/voidlink-ncm-adapter/sdkconfig.defaults
```kconfig
CONFIG_TINYUSB_NET_MODE_NCM=y
CONFIG_TINYUSB_DESC_PRODUCT_STRING="VoidLink T-Dongle USB Adapter"
CONFIG_TINYUSB_DESC_MANUFACTURER_STRING="ITSZ"
CONFIG_ESPTOOLPY_FLASHSIZE_16MB=y
CONFIG_ESPTOOLPY_FLASHSIZE="16MB"
CONFIG_PARTITION_TABLE_SINGLE_APP=y
```
